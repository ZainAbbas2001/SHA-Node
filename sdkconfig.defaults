## sdkconfig.defaults
```kconfig
# Target
CONFIG_IDF_TARGET="esp32s3"

# Flash
CONFIG_ESPTOOLPY_FLASHSIZE_8MB=y
CONFIG_PARTITION_TABLE_CUSTOM=y
CONFIG_PARTITION_TABLE_CUSTOM_FILENAME="partitions.csv"
CONFIG_PARTITION_TABLE_OFFSET=0x8000

# PSRAM — disabled for Wokwi simulation; enable via menuconfig for real hardware
# CONFIG_SPIRAM is not set

# CPU frequency
CONFIG_ESP32S3_DEFAULT_CPU_FREQ_240=y

# FreeRTOS
CONFIG_FREERTOS_HZ=1000
CONFIG_FREERTOS_USE_TICKLESS_IDLE=y
CONFIG_FREERTOS_TICKLESS_IDLE_THRESHOLD=3

# Logging
CONFIG_LOG_DEFAULT_LEVEL_INFO=y
CONFIG_LOG_COLORS=y

# I2C
CONFIG_I2C_ENABLE_DEBUG_LOG=n

# SPI / SD
CONFIG_FATFS_LFN_HEAP=y
CONFIG_FATFS_MAX_LFN=255
CONFIG_FATFS_PER_FILE_CACHE=y

# Wi-Fi
CONFIG_ESP_WIFI_STATIC_RX_BUFFER_NUM=10
CONFIG_ESP_WIFI_DYNAMIC_RX_BUFFER_NUM=32
CONFIG_ESP_WIFI_TX_BUFFER_TYPE_DYNAMIC=y

# MQTT
CONFIG_MQTT_TRANSPORT_SSL=y
CONFIG_MQTT_PROTOCOL_311=y

# OTA
CONFIG_OTA_ALLOW_HTTP=n
CONFIG_BOOTLOADER_APP_ROLLBACK_ENABLE=y

# Power management
CONFIG_PM_ENABLE=y
CONFIG_ESP_PHY_ENABLE_USB=y

# Watchdog
CONFIG_ESP_TASK_WDT_EN=y
CONFIG_ESP_TASK_WDT_TIMEOUT_S=30

# Stack overflow detection (shift stack sentinel to catch overflows)
CONFIG_FREERTOS_WATCHPOINT_END_OF_STACK=y

# Security
CONFIG_ESP_SYSTEM_PANIC_PRINT_REBOOT=y
```
